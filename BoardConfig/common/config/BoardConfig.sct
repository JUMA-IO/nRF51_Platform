; *************************************************************
; *** Scatter-Loading Description File generated by uVision ***
; *************************************************************

LR_IROM1 0x0002A000 0x00000400  {    ; load region size_region
  ER_IROM1 0x0002A000 0x00000400  {  ; load address = execution address
   *.o (user_information_config, +First)
   .ANY (+RO)
  }
}
