; *************************************************************
; *** Scatter-Loading Description File generated by uVision ***
; *************************************************************

LR_IROM1 0x10001000 0x00000100  {    ; load region size_region
  ER_IROM1 0x10001000 0x00000100  {  ; load address = execution address
   *.o (user_information_config, +First)
   .ANY (+RO)
  }
}
